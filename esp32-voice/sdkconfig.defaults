## esp32-voice/sdkconfig.defaults
```kconfig
# ESP32 Voice Device Default Configuration
# Following agtos.firmware.esp32.v1 specification

# Serial flasher config
CONFIG_ESPTOOLPY_FLASHSIZE_4MB=y
CONFIG_ESPTOOLPY_FLASHMODE_DIO=y
CONFIG_ESPTOOLPY_FLASHFREQ_80M=y
CONFIG_ESPTOOLPY_BAUD_921600B=y

# Partition Table
CONFIG_PARTITION_TABLE_CUSTOM=y
CONFIG_PARTITION_TABLE_CUSTOM_FILENAME="partitions.csv"
CONFIG_PARTITION_TABLE_FILENAME="partitions.csv"

# WiFi Configuration
CONFIG_ESP32_WIFI_STATIC_RX_BUFFER_NUM=10
CONFIG_ESP32_WIFI_DYNAMIC_RX_BUFFER_NUM=32
CONFIG_ESP32_WIFI_DYNAMIC_TX_BUFFER_NUM=32
CONFIG_ESP32_WIFI_AMPDU_TX_ENABLED=y
CONFIG_ESP32_WIFI_TX_BA_WIN=6
CONFIG_ESP32_WIFI_AMPDU_RX_ENABLED=y
CONFIG_ESP32_WIFI_RX_BA_WIN=6

# LWIP
CONFIG_LWIP_LOCAL_HOSTNAME="esp32-voice"
CONFIG_LWIP_TCPIP_RECVMBOX_SIZE=64

# HTTP Client
CONFIG_ESP_HTTP_CLIENT_ENABLE_HTTPS=y

# WebSocket Client
CONFIG_WEBSOCKET_BUFFER_SIZE=4096

# mDNS
CONFIG_MDNS_HOSTNAME="esp32-voice"
CONFIG_MDNS_INSTANCE_NAME="agtOS Voice Device"

# FreeRTOS
CONFIG_FREERTOS_HZ=1000
CONFIG_FREERTOS_UNICORE=n

# ESP System Settings
CONFIG_ESP_SYSTEM_EVENT_QUEUE_SIZE=32
CONFIG_ESP_SYSTEM_EVENT_TASK_STACK_SIZE=4096

# Log output
CONFIG_LOG_DEFAULT_LEVEL_INFO=y
CONFIG_LOG_COLORS=y
CONFIG_LOG_TIMESTAMP_SOURCE_RTOS=y

# SPIRAM (PSRAM) Support
CONFIG_SPIRAM=y
CONFIG_SPIRAM_USE_MALLOC=y
CONFIG_SPIRAM_MALLOC_ALWAYSINTERNAL=4096
CONFIG_SPIRAM_TRY_ALLOCATE_WIFI_LWIP=y

# App rollback
CONFIG_BOOTLOADER_APP_ROLLBACK_ENABLE=y
CONFIG_BOOTLOADER_APP_ANTI_ROLLBACK=y

# OTA
CONFIG_BOOTLOADER_NUM_PIN_APP_TEST=0

# I2S Configuration for INMP441
CONFIG_I2S_SUPPRESS_DEPRECATE_WARN=y

# Audio Processing
CONFIG_DSP_OPTIMIZED=y

# Custom Configuration Variables (referenced in code)
CONFIG_WIFI_SSID="YourWiFiSSID"
CONFIG_WIFI_PASSWORD="YourWiFiPassword"
CONFIG_DEVICE_ID="esp32-voice-001"
CONFIG_WEBRTC_SERVER="ws://192.168.1.100:3000/webrtc"
CONFIG_WAKE_WORD="hey_chichi"
```
